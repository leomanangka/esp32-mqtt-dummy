## components/mqtt-client-wrapper/Kconfig.projbuild
```kconfig
menu "MQTT configuration"

  config ESP_MQTT_BROKER_URL
    string "MQTT Broker URL"
    default ""
    help
      URL of the broker to connect to.

  config ESP_MQTT_BROKER_PORT
    int "MQTT Broker Port"
    default 1883
    help
      Port of the broker to connect to.

  config ESP_MQTT_AUTH_USERNAME
    string "Authentication username"
    default ""
    help
      MQTT username for authentication.

  config ESP_MQTT_AUTH_PASSWORD
    string "Authentication password"
    default ""
    help
      Password authentication.

endmenu
```

## components/network-wrapper/Kconfig.projbuild
```kconfig
menu "WiFi configuration"

  menu "STA configuration"
    comment "ESP WiFi STA configuration"

    config ESP_WIFI_STA_SSID
      string "WiFi STA SSID"
      default "wifi_name"
      help
        SSID (network name) for the example to connect to.

    config ESP_WIFI_STA_PASSWORD
      string "WiFi STA Password"
      default "wifi_password"
      help
        WiFi password (WPA or WPA2) for the example to use.
  
    choice ESP_WIFI_SAE_MODE
      prompt "WPA3 SAE mode selection"
      default ESP_WPA3_SAE_PWE_BOTH
      help
        Select mode for SAE as Hunt and Peck, H2E or both.

      config ESP_WPA3_SAE_PWE_HUNT_AND_PECK
          bool "HUNT AND PECK"
      config ESP_WPA3_SAE_PWE_HASH_TO_ELEMENT
          bool "H2E"
      config ESP_WPA3_SAE_PWE_BOTH
          bool "BOTH"
    endchoice
  
    config ESP_WIFI_PW_ID
      string "PASSWORD IDENTIFIER"
      depends on  ESP_WPA3_SAE_PWE_HASH_TO_ELEMENT|| ESP_WPA3_SAE_PWE_BOTH
      default ""
      help
        password identifier for SAE H2E
  
    config ESP_MAXIMUM_RETRY
      int "Maximum retry"
      default 5
      help
        Set the Maximum retry to avoid station reconnecting to the AP unlimited when the AP is really inexistent.
  
    choice ESP_WIFI_SCAN_AUTH_MODE_THRESHOLD
      prompt "WiFi Scan auth mode threshold"
      default ESP_WIFI_AUTH_WPA2_PSK
      help
        The weakest authmode to accept in the scan mode.
        This value defaults to ESP_WIFI_AUTH_WPA2_PSK incase password is present and ESP_WIFI_AUTH_OPEN is used.
        Please select ESP_WIFI_AUTH_WEP/ESP_WIFI_AUTH_WPA_PSK incase AP is operating in WEP/WPA mode.

      config ESP_WIFI_AUTH_OPEN
        bool "OPEN"
      config ESP_WIFI_AUTH_WEP
        bool "WEP"
      config ESP_WIFI_AUTH_WPA_PSK
        bool "WPA PSK"
      config ESP_WIFI_AUTH_WPA2_PSK
        bool "WPA2 PSK"
      config ESP_WIFI_AUTH_WPA_WPA2_PSK
        bool "WPA/WPA2 PSK"
      config ESP_WIFI_AUTH_WPA3_PSK
        bool "WPA3 PSK"
      config ESP_WIFI_AUTH_WPA2_WPA3_PSK
        bool "WPA2/WPA3 PSK"
      config ESP_WIFI_AUTH_WAPI_PSK
        bool "WAPI PSK"
    endchoice
  endmenu

  menu "SoftAP configuration"
    comment "ESP WiFi SoftAP configuration"

    config ESP_WIFI_AP_SSID
      string "WiFi AP SSID"
      default "myssid"
      help
        SSID (network name) of the AP for the example to connect to.

    config ESP_WIFI_AP_PASSWORD
      string "WiFi AP Password"
      default "mypassword"
      help
        WiFi password of the AP for the example to use.

    config ESP_WIFI_AP_CHANNEL
      int "WiFi AP Channel"
      range 1 14
      default 1
      help
        WiFi channel (network channel) of the AP for the example to use.

    config ESP_MAX_STA_CONN_AP
      int "Maximal STA connections"
      default 4
      help
        Max number of the STA connects to AP.
  endmenu

  choice ESP_WIFI_MODE
    prompt "ESP WiFi mode option"
    default ESP_WIFI_MODE_STA
    help
      Choose WiFi mode between AP or STA

    config ESP_WIFI_MODE_STA
      bool "STA"
    config ESP_WIFI_MODE_AP
      bool "AP"
  endchoice

endmenu
```
